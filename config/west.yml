## config/west.yml
```yaml
manifest:
  remotes:
    - name: zmkfirmware
      url-base: https://github.com/zmkfirmware
    - name: menneric84
      url-base: https://github.com/menneric84
  projects:
    - name: zmk
      remote: zmkfirmware
      revision: v0.2
      import: app/west.yml
    - name: badjeff-zmk-pmw3610-driver
      remote: menneric84
      revision: 8020cea1824a49968bf1fa1438d3c0467b1d953f
  self:
    path: config
```
